;
; File Name: cyfitterrv.inc
; 
; PSoC Creator  4.2
;
; Description:
; 
;
;-------------------------------------------------------------------------------
; Copyright (c) 2007-2018 Cypress Semiconductor.  All rights reserved.
; You may use this file only in accordance with the license, terms, conditions, 
; disclaimers, and limitations in the end user license agreement accompanying 
; the software package with which this file was provided.
;-------------------------------------------------------------------------------

    IF :LNOT::DEF:INCLUDED_CYFITTERRV_INC
INCLUDED_CYFITTERRV_INC EQU 1
    GET cydevicerv.inc
    GET cydevicerv_trm.inc

; LED1
LED1__0__INTTYPE EQU CYREG_PICU0_INTTYPE6
LED1__0__MASK EQU 0x40
LED1__0__PC EQU CYREG_PRT0_PC6
LED1__0__PORT EQU 0
LED1__0__SHIFT EQU 6
LED1__AG EQU CYREG_PRT0_AG
LED1__AMUX EQU CYREG_PRT0_AMUX
LED1__BIE EQU CYREG_PRT0_BIE
LED1__BIT_MASK EQU CYREG_PRT0_BIT_MASK
LED1__BYP EQU CYREG_PRT0_BYP
LED1__CTL EQU CYREG_PRT0_CTL
LED1__DM0 EQU CYREG_PRT0_DM0
LED1__DM1 EQU CYREG_PRT0_DM1
LED1__DM2 EQU CYREG_PRT0_DM2
LED1__DR EQU CYREG_PRT0_DR
LED1__INP_DIS EQU CYREG_PRT0_INP_DIS
LED1__INTTYPE_BASE EQU CYDEV_PICU_INTTYPE_PICU0_BASE
LED1__LCD_COM_SEG EQU CYREG_PRT0_LCD_COM_SEG
LED1__LCD_EN EQU CYREG_PRT0_LCD_EN
LED1__MASK EQU 0x40
LED1__PORT EQU 0
LED1__PRT EQU CYREG_PRT0_PRT
LED1__PRTDSI__CAPS_SEL EQU CYREG_PRT0_CAPS_SEL
LED1__PRTDSI__DBL_SYNC_IN EQU CYREG_PRT0_DBL_SYNC_IN
LED1__PRTDSI__OE_SEL0 EQU CYREG_PRT0_OE_SEL0
LED1__PRTDSI__OE_SEL1 EQU CYREG_PRT0_OE_SEL1
LED1__PRTDSI__OUT_SEL0 EQU CYREG_PRT0_OUT_SEL0
LED1__PRTDSI__OUT_SEL1 EQU CYREG_PRT0_OUT_SEL1
LED1__PRTDSI__SYNC_OUT EQU CYREG_PRT0_SYNC_OUT
LED1__PS EQU CYREG_PRT0_PS
LED1__SHIFT EQU 6
LED1__SLW EQU CYREG_PRT0_SLW

; LED2
LED2__0__INTTYPE EQU CYREG_PICU0_INTTYPE0
LED2__0__MASK EQU 0x01
LED2__0__PC EQU CYREG_PRT0_PC0
LED2__0__PORT EQU 0
LED2__0__SHIFT EQU 0
LED2__AG EQU CYREG_PRT0_AG
LED2__AMUX EQU CYREG_PRT0_AMUX
LED2__BIE EQU CYREG_PRT0_BIE
LED2__BIT_MASK EQU CYREG_PRT0_BIT_MASK
LED2__BYP EQU CYREG_PRT0_BYP
LED2__CTL EQU CYREG_PRT0_CTL
LED2__DM0 EQU CYREG_PRT0_DM0
LED2__DM1 EQU CYREG_PRT0_DM1
LED2__DM2 EQU CYREG_PRT0_DM2
LED2__DR EQU CYREG_PRT0_DR
LED2__INP_DIS EQU CYREG_PRT0_INP_DIS
LED2__INTTYPE_BASE EQU CYDEV_PICU_INTTYPE_PICU0_BASE
LED2__LCD_COM_SEG EQU CYREG_PRT0_LCD_COM_SEG
LED2__LCD_EN EQU CYREG_PRT0_LCD_EN
LED2__MASK EQU 0x01
LED2__PORT EQU 0
LED2__PRT EQU CYREG_PRT0_PRT
LED2__PRTDSI__CAPS_SEL EQU CYREG_PRT0_CAPS_SEL
LED2__PRTDSI__DBL_SYNC_IN EQU CYREG_PRT0_DBL_SYNC_IN
LED2__PRTDSI__OE_SEL0 EQU CYREG_PRT0_OE_SEL0
LED2__PRTDSI__OE_SEL1 EQU CYREG_PRT0_OE_SEL1
LED2__PRTDSI__OUT_SEL0 EQU CYREG_PRT0_OUT_SEL0
LED2__PRTDSI__OUT_SEL1 EQU CYREG_PRT0_OUT_SEL1
LED2__PRTDSI__SYNC_OUT EQU CYREG_PRT0_SYNC_OUT
LED2__PS EQU CYREG_PRT0_PS
LED2__SHIFT EQU 0
LED2__SLW EQU CYREG_PRT0_SLW

; LED3
LED3__0__INTTYPE EQU CYREG_PICU0_INTTYPE1
LED3__0__MASK EQU 0x02
LED3__0__PC EQU CYREG_PRT0_PC1
LED3__0__PORT EQU 0
LED3__0__SHIFT EQU 1
LED3__AG EQU CYREG_PRT0_AG
LED3__AMUX EQU CYREG_PRT0_AMUX
LED3__BIE EQU CYREG_PRT0_BIE
LED3__BIT_MASK EQU CYREG_PRT0_BIT_MASK
LED3__BYP EQU CYREG_PRT0_BYP
LED3__CTL EQU CYREG_PRT0_CTL
LED3__DM0 EQU CYREG_PRT0_DM0
LED3__DM1 EQU CYREG_PRT0_DM1
LED3__DM2 EQU CYREG_PRT0_DM2
LED3__DR EQU CYREG_PRT0_DR
LED3__INP_DIS EQU CYREG_PRT0_INP_DIS
LED3__INTTYPE_BASE EQU CYDEV_PICU_INTTYPE_PICU0_BASE
LED3__LCD_COM_SEG EQU CYREG_PRT0_LCD_COM_SEG
LED3__LCD_EN EQU CYREG_PRT0_LCD_EN
LED3__MASK EQU 0x02
LED3__PORT EQU 0
LED3__PRT EQU CYREG_PRT0_PRT
LED3__PRTDSI__CAPS_SEL EQU CYREG_PRT0_CAPS_SEL
LED3__PRTDSI__DBL_SYNC_IN EQU CYREG_PRT0_DBL_SYNC_IN
LED3__PRTDSI__OE_SEL0 EQU CYREG_PRT0_OE_SEL0
LED3__PRTDSI__OE_SEL1 EQU CYREG_PRT0_OE_SEL1
LED3__PRTDSI__OUT_SEL0 EQU CYREG_PRT0_OUT_SEL0
LED3__PRTDSI__OUT_SEL1 EQU CYREG_PRT0_OUT_SEL1
LED3__PRTDSI__SYNC_OUT EQU CYREG_PRT0_SYNC_OUT
LED3__PS EQU CYREG_PRT0_PS
LED3__SHIFT EQU 1
LED3__SLW EQU CYREG_PRT0_SLW

; LED4
LED4__0__INTTYPE EQU CYREG_PICU15_INTTYPE0
LED4__0__MASK EQU 0x01
LED4__0__PC EQU CYREG_IO_PC_PRT15_PC0
LED4__0__PORT EQU 15
LED4__0__SHIFT EQU 0
LED4__AG EQU CYREG_PRT15_AG
LED4__AMUX EQU CYREG_PRT15_AMUX
LED4__BIE EQU CYREG_PRT15_BIE
LED4__BIT_MASK EQU CYREG_PRT15_BIT_MASK
LED4__BYP EQU CYREG_PRT15_BYP
LED4__CTL EQU CYREG_PRT15_CTL
LED4__DM0 EQU CYREG_PRT15_DM0
LED4__DM1 EQU CYREG_PRT15_DM1
LED4__DM2 EQU CYREG_PRT15_DM2
LED4__DR EQU CYREG_PRT15_DR
LED4__INP_DIS EQU CYREG_PRT15_INP_DIS
LED4__INTTYPE_BASE EQU CYDEV_PICU_INTTYPE_PICU15_BASE
LED4__LCD_COM_SEG EQU CYREG_PRT15_LCD_COM_SEG
LED4__LCD_EN EQU CYREG_PRT15_LCD_EN
LED4__MASK EQU 0x01
LED4__PORT EQU 15
LED4__PRT EQU CYREG_PRT15_PRT
LED4__PRTDSI__CAPS_SEL EQU CYREG_PRT15_CAPS_SEL
LED4__PRTDSI__DBL_SYNC_IN EQU CYREG_PRT15_DBL_SYNC_IN
LED4__PRTDSI__OE_SEL0 EQU CYREG_PRT15_OE_SEL0
LED4__PRTDSI__OE_SEL1 EQU CYREG_PRT15_OE_SEL1
LED4__PRTDSI__OUT_SEL0 EQU CYREG_PRT15_OUT_SEL0
LED4__PRTDSI__OUT_SEL1 EQU CYREG_PRT15_OUT_SEL1
LED4__PRTDSI__SYNC_OUT EQU CYREG_PRT15_SYNC_OUT
LED4__PS EQU CYREG_PRT15_PS
LED4__SHIFT EQU 0
LED4__SLW EQU CYREG_PRT15_SLW

; LED5
LED5__0__INTTYPE EQU CYREG_PICU15_INTTYPE1
LED5__0__MASK EQU 0x02
LED5__0__PC EQU CYREG_IO_PC_PRT15_PC1
LED5__0__PORT EQU 15
LED5__0__SHIFT EQU 1
LED5__AG EQU CYREG_PRT15_AG
LED5__AMUX EQU CYREG_PRT15_AMUX
LED5__BIE EQU CYREG_PRT15_BIE
LED5__BIT_MASK EQU CYREG_PRT15_BIT_MASK
LED5__BYP EQU CYREG_PRT15_BYP
LED5__CTL EQU CYREG_PRT15_CTL
LED5__DM0 EQU CYREG_PRT15_DM0
LED5__DM1 EQU CYREG_PRT15_DM1
LED5__DM2 EQU CYREG_PRT15_DM2
LED5__DR EQU CYREG_PRT15_DR
LED5__INP_DIS EQU CYREG_PRT15_INP_DIS
LED5__INTTYPE_BASE EQU CYDEV_PICU_INTTYPE_PICU15_BASE
LED5__LCD_COM_SEG EQU CYREG_PRT15_LCD_COM_SEG
LED5__LCD_EN EQU CYREG_PRT15_LCD_EN
LED5__MASK EQU 0x02
LED5__PORT EQU 15
LED5__PRT EQU CYREG_PRT15_PRT
LED5__PRTDSI__CAPS_SEL EQU CYREG_PRT15_CAPS_SEL
LED5__PRTDSI__DBL_SYNC_IN EQU CYREG_PRT15_DBL_SYNC_IN
LED5__PRTDSI__OE_SEL0 EQU CYREG_PRT15_OE_SEL0
LED5__PRTDSI__OE_SEL1 EQU CYREG_PRT15_OE_SEL1
LED5__PRTDSI__OUT_SEL0 EQU CYREG_PRT15_OUT_SEL0
LED5__PRTDSI__OUT_SEL1 EQU CYREG_PRT15_OUT_SEL1
LED5__PRTDSI__SYNC_OUT EQU CYREG_PRT15_SYNC_OUT
LED5__PS EQU CYREG_PRT15_PS
LED5__SHIFT EQU 1
LED5__SLW EQU CYREG_PRT15_SLW

; PWM_1
PWM_1_PWMUDB_genblk1_ctrlreg__16BIT_CONTROL_AUX_CTL_REG EQU CYREG_B0_UDB07_08_ACTL
PWM_1_PWMUDB_genblk1_ctrlreg__16BIT_CONTROL_CONTROL_REG EQU CYREG_B0_UDB07_08_CTL
PWM_1_PWMUDB_genblk1_ctrlreg__16BIT_CONTROL_COUNT_REG EQU CYREG_B0_UDB07_08_CTL
PWM_1_PWMUDB_genblk1_ctrlreg__16BIT_COUNT_CONTROL_REG EQU CYREG_B0_UDB07_08_CTL
PWM_1_PWMUDB_genblk1_ctrlreg__16BIT_COUNT_COUNT_REG EQU CYREG_B0_UDB07_08_CTL
PWM_1_PWMUDB_genblk1_ctrlreg__16BIT_MASK_MASK_REG EQU CYREG_B0_UDB07_08_MSK
PWM_1_PWMUDB_genblk1_ctrlreg__16BIT_MASK_PERIOD_REG EQU CYREG_B0_UDB07_08_MSK
PWM_1_PWMUDB_genblk1_ctrlreg__16BIT_PERIOD_MASK_REG EQU CYREG_B0_UDB07_08_MSK
PWM_1_PWMUDB_genblk1_ctrlreg__16BIT_PERIOD_PERIOD_REG EQU CYREG_B0_UDB07_08_MSK
PWM_1_PWMUDB_genblk1_ctrlreg__7__MASK EQU 0x80
PWM_1_PWMUDB_genblk1_ctrlreg__7__POS EQU 7
PWM_1_PWMUDB_genblk1_ctrlreg__CONTROL_AUX_CTL_REG EQU CYREG_B0_UDB07_ACTL
PWM_1_PWMUDB_genblk1_ctrlreg__CONTROL_REG EQU CYREG_B0_UDB07_CTL
PWM_1_PWMUDB_genblk1_ctrlreg__CONTROL_ST_REG EQU CYREG_B0_UDB07_ST_CTL
PWM_1_PWMUDB_genblk1_ctrlreg__COUNT_REG EQU CYREG_B0_UDB07_CTL
PWM_1_PWMUDB_genblk1_ctrlreg__COUNT_ST_REG EQU CYREG_B0_UDB07_ST_CTL
PWM_1_PWMUDB_genblk1_ctrlreg__MASK EQU 0x80
PWM_1_PWMUDB_genblk1_ctrlreg__MASK_CTL_AUX_CTL_REG EQU CYREG_B0_UDB07_MSK_ACTL
PWM_1_PWMUDB_genblk1_ctrlreg__PER_CTL_AUX_CTL_REG EQU CYREG_B0_UDB07_MSK_ACTL
PWM_1_PWMUDB_genblk1_ctrlreg__PERIOD_REG EQU CYREG_B0_UDB07_MSK
PWM_1_PWMUDB_genblk8_stsreg__0__MASK EQU 0x01
PWM_1_PWMUDB_genblk8_stsreg__0__POS EQU 0
PWM_1_PWMUDB_genblk8_stsreg__16BIT_STATUS_AUX_CTL_REG EQU CYREG_B0_UDB07_08_ACTL
PWM_1_PWMUDB_genblk8_stsreg__16BIT_STATUS_REG EQU CYREG_B0_UDB07_08_ST
PWM_1_PWMUDB_genblk8_stsreg__2__MASK EQU 0x04
PWM_1_PWMUDB_genblk8_stsreg__2__POS EQU 2
PWM_1_PWMUDB_genblk8_stsreg__3__MASK EQU 0x08
PWM_1_PWMUDB_genblk8_stsreg__3__POS EQU 3
PWM_1_PWMUDB_genblk8_stsreg__MASK EQU 0x0D
PWM_1_PWMUDB_genblk8_stsreg__MASK_REG EQU CYREG_B0_UDB07_MSK
PWM_1_PWMUDB_genblk8_stsreg__MASK_ST_AUX_CTL_REG EQU CYREG_B0_UDB07_MSK_ACTL
PWM_1_PWMUDB_genblk8_stsreg__PER_ST_AUX_CTL_REG EQU CYREG_B0_UDB07_MSK_ACTL
PWM_1_PWMUDB_genblk8_stsreg__STATUS_AUX_CTL_REG EQU CYREG_B0_UDB07_ACTL
PWM_1_PWMUDB_genblk8_stsreg__STATUS_CNT_REG EQU CYREG_B0_UDB07_ST_CTL
PWM_1_PWMUDB_genblk8_stsreg__STATUS_CONTROL_REG EQU CYREG_B0_UDB07_ST_CTL
PWM_1_PWMUDB_genblk8_stsreg__STATUS_REG EQU CYREG_B0_UDB07_ST
PWM_1_PWMUDB_sP16_pwmdp_u0__16BIT_A0_REG EQU CYREG_B0_UDB06_07_A0
PWM_1_PWMUDB_sP16_pwmdp_u0__16BIT_A1_REG EQU CYREG_B0_UDB06_07_A1
PWM_1_PWMUDB_sP16_pwmdp_u0__16BIT_D0_REG EQU CYREG_B0_UDB06_07_D0
PWM_1_PWMUDB_sP16_pwmdp_u0__16BIT_D1_REG EQU CYREG_B0_UDB06_07_D1
PWM_1_PWMUDB_sP16_pwmdp_u0__16BIT_DP_AUX_CTL_REG EQU CYREG_B0_UDB06_07_ACTL
PWM_1_PWMUDB_sP16_pwmdp_u0__16BIT_F0_REG EQU CYREG_B0_UDB06_07_F0
PWM_1_PWMUDB_sP16_pwmdp_u0__16BIT_F1_REG EQU CYREG_B0_UDB06_07_F1
PWM_1_PWMUDB_sP16_pwmdp_u0__A0_A1_REG EQU CYREG_B0_UDB06_A0_A1
PWM_1_PWMUDB_sP16_pwmdp_u0__A0_REG EQU CYREG_B0_UDB06_A0
PWM_1_PWMUDB_sP16_pwmdp_u0__A1_REG EQU CYREG_B0_UDB06_A1
PWM_1_PWMUDB_sP16_pwmdp_u0__D0_D1_REG EQU CYREG_B0_UDB06_D0_D1
PWM_1_PWMUDB_sP16_pwmdp_u0__D0_REG EQU CYREG_B0_UDB06_D0
PWM_1_PWMUDB_sP16_pwmdp_u0__D1_REG EQU CYREG_B0_UDB06_D1
PWM_1_PWMUDB_sP16_pwmdp_u0__DP_AUX_CTL_REG EQU CYREG_B0_UDB06_ACTL
PWM_1_PWMUDB_sP16_pwmdp_u0__F0_F1_REG EQU CYREG_B0_UDB06_F0_F1
PWM_1_PWMUDB_sP16_pwmdp_u0__F0_REG EQU CYREG_B0_UDB06_F0
PWM_1_PWMUDB_sP16_pwmdp_u0__F1_REG EQU CYREG_B0_UDB06_F1
PWM_1_PWMUDB_sP16_pwmdp_u1__16BIT_A0_REG EQU CYREG_B0_UDB07_08_A0
PWM_1_PWMUDB_sP16_pwmdp_u1__16BIT_A1_REG EQU CYREG_B0_UDB07_08_A1
PWM_1_PWMUDB_sP16_pwmdp_u1__16BIT_D0_REG EQU CYREG_B0_UDB07_08_D0
PWM_1_PWMUDB_sP16_pwmdp_u1__16BIT_D1_REG EQU CYREG_B0_UDB07_08_D1
PWM_1_PWMUDB_sP16_pwmdp_u1__16BIT_DP_AUX_CTL_REG EQU CYREG_B0_UDB07_08_ACTL
PWM_1_PWMUDB_sP16_pwmdp_u1__16BIT_F0_REG EQU CYREG_B0_UDB07_08_F0
PWM_1_PWMUDB_sP16_pwmdp_u1__16BIT_F1_REG EQU CYREG_B0_UDB07_08_F1
PWM_1_PWMUDB_sP16_pwmdp_u1__A0_A1_REG EQU CYREG_B0_UDB07_A0_A1
PWM_1_PWMUDB_sP16_pwmdp_u1__A0_REG EQU CYREG_B0_UDB07_A0
PWM_1_PWMUDB_sP16_pwmdp_u1__A1_REG EQU CYREG_B0_UDB07_A1
PWM_1_PWMUDB_sP16_pwmdp_u1__D0_D1_REG EQU CYREG_B0_UDB07_D0_D1
PWM_1_PWMUDB_sP16_pwmdp_u1__D0_REG EQU CYREG_B0_UDB07_D0
PWM_1_PWMUDB_sP16_pwmdp_u1__D1_REG EQU CYREG_B0_UDB07_D1
PWM_1_PWMUDB_sP16_pwmdp_u1__DP_AUX_CTL_REG EQU CYREG_B0_UDB07_ACTL
PWM_1_PWMUDB_sP16_pwmdp_u1__F0_F1_REG EQU CYREG_B0_UDB07_F0_F1
PWM_1_PWMUDB_sP16_pwmdp_u1__F0_REG EQU CYREG_B0_UDB07_F0
PWM_1_PWMUDB_sP16_pwmdp_u1__F1_REG EQU CYREG_B0_UDB07_F1
PWM_1_PWMUDB_sP16_pwmdp_u1__MSK_DP_AUX_CTL_REG EQU CYREG_B0_UDB07_MSK_ACTL
PWM_1_PWMUDB_sP16_pwmdp_u1__PER_DP_AUX_CTL_REG EQU CYREG_B0_UDB07_MSK_ACTL

; Clock_1
Clock_1__CFG0 EQU CYREG_CLKDIST_DCFG0_CFG0
Clock_1__CFG1 EQU CYREG_CLKDIST_DCFG0_CFG1
Clock_1__CFG2 EQU CYREG_CLKDIST_DCFG0_CFG2
Clock_1__CFG2_SRC_SEL_MASK EQU 0x07
Clock_1__INDEX EQU 0x00
Clock_1__PM_ACT_CFG EQU CYREG_PM_ACT_CFG2
Clock_1__PM_ACT_MSK EQU 0x01
Clock_1__PM_STBY_CFG EQU CYREG_PM_STBY_CFG2
Clock_1__PM_STBY_MSK EQU 0x01

; VDAC8_1
VDAC8_1_viDAC8__CR0 EQU CYREG_DAC1_CR0
VDAC8_1_viDAC8__CR1 EQU CYREG_DAC1_CR1
VDAC8_1_viDAC8__D EQU CYREG_DAC1_D
VDAC8_1_viDAC8__PM_ACT_CFG EQU CYREG_PM_ACT_CFG8
VDAC8_1_viDAC8__PM_ACT_MSK EQU 0x02
VDAC8_1_viDAC8__PM_STBY_CFG EQU CYREG_PM_STBY_CFG8
VDAC8_1_viDAC8__PM_STBY_MSK EQU 0x02
VDAC8_1_viDAC8__STROBE EQU CYREG_DAC1_STROBE
VDAC8_1_viDAC8__SW0 EQU CYREG_DAC1_SW0
VDAC8_1_viDAC8__SW2 EQU CYREG_DAC1_SW2
VDAC8_1_viDAC8__SW3 EQU CYREG_DAC1_SW3
VDAC8_1_viDAC8__SW4 EQU CYREG_DAC1_SW4
VDAC8_1_viDAC8__TR EQU CYREG_DAC1_TR
VDAC8_1_viDAC8__TRIM__M1 EQU CYREG_FLSHID_CUST_TABLES_DAC1_M1
VDAC8_1_viDAC8__TRIM__M2 EQU CYREG_FLSHID_CUST_TABLES_DAC1_M2
VDAC8_1_viDAC8__TRIM__M3 EQU CYREG_FLSHID_CUST_TABLES_DAC1_M3
VDAC8_1_viDAC8__TRIM__M4 EQU CYREG_FLSHID_CUST_TABLES_DAC1_M4
VDAC8_1_viDAC8__TRIM__M5 EQU CYREG_FLSHID_CUST_TABLES_DAC1_M5
VDAC8_1_viDAC8__TRIM__M6 EQU CYREG_FLSHID_CUST_TABLES_DAC1_M6
VDAC8_1_viDAC8__TRIM__M7 EQU CYREG_FLSHID_CUST_TABLES_DAC1_M7
VDAC8_1_viDAC8__TRIM__M8 EQU CYREG_FLSHID_CUST_TABLES_DAC1_M8
VDAC8_1_viDAC8__TST EQU CYREG_DAC1_TST

; Vref_DAC1
Vref_DAC1__0__INTTYPE EQU CYREG_PICU2_INTTYPE3
Vref_DAC1__0__MASK EQU 0x08
Vref_DAC1__0__PC EQU CYREG_PRT2_PC3
Vref_DAC1__0__PORT EQU 2
Vref_DAC1__0__SHIFT EQU 3
Vref_DAC1__AG EQU CYREG_PRT2_AG
Vref_DAC1__AMUX EQU CYREG_PRT2_AMUX
Vref_DAC1__BIE EQU CYREG_PRT2_BIE
Vref_DAC1__BIT_MASK EQU CYREG_PRT2_BIT_MASK
Vref_DAC1__BYP EQU CYREG_PRT2_BYP
Vref_DAC1__CTL EQU CYREG_PRT2_CTL
Vref_DAC1__DM0 EQU CYREG_PRT2_DM0
Vref_DAC1__DM1 EQU CYREG_PRT2_DM1
Vref_DAC1__DM2 EQU CYREG_PRT2_DM2
Vref_DAC1__DR EQU CYREG_PRT2_DR
Vref_DAC1__INP_DIS EQU CYREG_PRT2_INP_DIS
Vref_DAC1__INTTYPE_BASE EQU CYDEV_PICU_INTTYPE_PICU2_BASE
Vref_DAC1__LCD_COM_SEG EQU CYREG_PRT2_LCD_COM_SEG
Vref_DAC1__LCD_EN EQU CYREG_PRT2_LCD_EN
Vref_DAC1__MASK EQU 0x08
Vref_DAC1__PORT EQU 2
Vref_DAC1__PRT EQU CYREG_PRT2_PRT
Vref_DAC1__PRTDSI__CAPS_SEL EQU CYREG_PRT2_CAPS_SEL
Vref_DAC1__PRTDSI__DBL_SYNC_IN EQU CYREG_PRT2_DBL_SYNC_IN
Vref_DAC1__PRTDSI__OE_SEL0 EQU CYREG_PRT2_OE_SEL0
Vref_DAC1__PRTDSI__OE_SEL1 EQU CYREG_PRT2_OE_SEL1
Vref_DAC1__PRTDSI__OUT_SEL0 EQU CYREG_PRT2_OUT_SEL0
Vref_DAC1__PRTDSI__OUT_SEL1 EQU CYREG_PRT2_OUT_SEL1
Vref_DAC1__PRTDSI__SYNC_OUT EQU CYREG_PRT2_SYNC_OUT
Vref_DAC1__PS EQU CYREG_PRT2_PS
Vref_DAC1__SHIFT EQU 3
Vref_DAC1__SLW EQU CYREG_PRT2_SLW

; Vref_DAC2
Vref_DAC2__0__INTTYPE EQU CYREG_PICU3_INTTYPE3
Vref_DAC2__0__MASK EQU 0x08
Vref_DAC2__0__PC EQU CYREG_PRT3_PC3
Vref_DAC2__0__PORT EQU 3
Vref_DAC2__0__SHIFT EQU 3
Vref_DAC2__AG EQU CYREG_PRT3_AG
Vref_DAC2__AMUX EQU CYREG_PRT3_AMUX
Vref_DAC2__BIE EQU CYREG_PRT3_BIE
Vref_DAC2__BIT_MASK EQU CYREG_PRT3_BIT_MASK
Vref_DAC2__BYP EQU CYREG_PRT3_BYP
Vref_DAC2__CTL EQU CYREG_PRT3_CTL
Vref_DAC2__DM0 EQU CYREG_PRT3_DM0
Vref_DAC2__DM1 EQU CYREG_PRT3_DM1
Vref_DAC2__DM2 EQU CYREG_PRT3_DM2
Vref_DAC2__DR EQU CYREG_PRT3_DR
Vref_DAC2__INP_DIS EQU CYREG_PRT3_INP_DIS
Vref_DAC2__INTTYPE_BASE EQU CYDEV_PICU_INTTYPE_PICU3_BASE
Vref_DAC2__LCD_COM_SEG EQU CYREG_PRT3_LCD_COM_SEG
Vref_DAC2__LCD_EN EQU CYREG_PRT3_LCD_EN
Vref_DAC2__MASK EQU 0x08
Vref_DAC2__PORT EQU 3
Vref_DAC2__PRT EQU CYREG_PRT3_PRT
Vref_DAC2__PRTDSI__CAPS_SEL EQU CYREG_PRT3_CAPS_SEL
Vref_DAC2__PRTDSI__DBL_SYNC_IN EQU CYREG_PRT3_DBL_SYNC_IN
Vref_DAC2__PRTDSI__OE_SEL0 EQU CYREG_PRT3_OE_SEL0
Vref_DAC2__PRTDSI__OE_SEL1 EQU CYREG_PRT3_OE_SEL1
Vref_DAC2__PRTDSI__OUT_SEL0 EQU CYREG_PRT3_OUT_SEL0
Vref_DAC2__PRTDSI__OUT_SEL1 EQU CYREG_PRT3_OUT_SEL1
Vref_DAC2__PRTDSI__SYNC_OUT EQU CYREG_PRT3_SYNC_OUT
Vref_DAC2__PS EQU CYREG_PRT3_PS
Vref_DAC2__SHIFT EQU 3
Vref_DAC2__SLW EQU CYREG_PRT3_SLW

; Miscellaneous
BCLK__BUS_CLK__HZ EQU 24000000
BCLK__BUS_CLK__KHZ EQU 24000
BCLK__BUS_CLK__MHZ EQU 24
CYDEV_CHIP_DIE_LEOPARD EQU 1
CYDEV_CHIP_DIE_PSOC4A EQU 18
CYDEV_CHIP_DIE_PSOC5LP EQU 2
CYDEV_CHIP_DIE_PSOC5TM EQU 3
CYDEV_CHIP_DIE_TMA4 EQU 4
CYDEV_CHIP_DIE_UNKNOWN EQU 0
CYDEV_CHIP_FAMILY_FM0P EQU 5
CYDEV_CHIP_FAMILY_FM3 EQU 6
CYDEV_CHIP_FAMILY_FM4 EQU 7
CYDEV_CHIP_FAMILY_PSOC3 EQU 1
CYDEV_CHIP_FAMILY_PSOC4 EQU 2
CYDEV_CHIP_FAMILY_PSOC5 EQU 3
CYDEV_CHIP_FAMILY_PSOC6 EQU 4
CYDEV_CHIP_FAMILY_UNKNOWN EQU 0
CYDEV_CHIP_FAMILY_USED EQU CYDEV_CHIP_FAMILY_PSOC5
CYDEV_CHIP_JTAG_ID EQU 0x2E161069
CYDEV_CHIP_MEMBER_3A EQU 1
CYDEV_CHIP_MEMBER_4A EQU 18
CYDEV_CHIP_MEMBER_4D EQU 13
CYDEV_CHIP_MEMBER_4E EQU 6
CYDEV_CHIP_MEMBER_4F EQU 19
CYDEV_CHIP_MEMBER_4G EQU 4
CYDEV_CHIP_MEMBER_4H EQU 17
CYDEV_CHIP_MEMBER_4I EQU 23
CYDEV_CHIP_MEMBER_4J EQU 14
CYDEV_CHIP_MEMBER_4K EQU 15
CYDEV_CHIP_MEMBER_4L EQU 22
CYDEV_CHIP_MEMBER_4M EQU 21
CYDEV_CHIP_MEMBER_4N EQU 10
CYDEV_CHIP_MEMBER_4O EQU 7
CYDEV_CHIP_MEMBER_4P EQU 20
CYDEV_CHIP_MEMBER_4Q EQU 12
CYDEV_CHIP_MEMBER_4R EQU 8
CYDEV_CHIP_MEMBER_4S EQU 11
CYDEV_CHIP_MEMBER_4T EQU 9
CYDEV_CHIP_MEMBER_4U EQU 5
CYDEV_CHIP_MEMBER_4V EQU 16
CYDEV_CHIP_MEMBER_5A EQU 3
CYDEV_CHIP_MEMBER_5B EQU 2
CYDEV_CHIP_MEMBER_6A EQU 24
CYDEV_CHIP_MEMBER_FM3 EQU 28
CYDEV_CHIP_MEMBER_FM4 EQU 29
CYDEV_CHIP_MEMBER_PDL_FM0P_TYPE1 EQU 25
CYDEV_CHIP_MEMBER_PDL_FM0P_TYPE2 EQU 26
CYDEV_CHIP_MEMBER_PDL_FM0P_TYPE3 EQU 27
CYDEV_CHIP_MEMBER_UNKNOWN EQU 0
CYDEV_CHIP_MEMBER_USED EQU CYDEV_CHIP_MEMBER_5B
CYDEV_CHIP_DIE_EXPECT EQU CYDEV_CHIP_MEMBER_USED
CYDEV_CHIP_DIE_ACTUAL EQU CYDEV_CHIP_DIE_EXPECT
CYDEV_CHIP_REV_LEOPARD_ES1 EQU 0
CYDEV_CHIP_REV_LEOPARD_ES2 EQU 1
CYDEV_CHIP_REV_LEOPARD_ES3 EQU 3
CYDEV_CHIP_REV_LEOPARD_PRODUCTION EQU 3
CYDEV_CHIP_REV_PSOC4A_ES0 EQU 17
CYDEV_CHIP_REV_PSOC4A_PRODUCTION EQU 17
CYDEV_CHIP_REV_PSOC5LP_ES0 EQU 0
CYDEV_CHIP_REV_PSOC5LP_PRODUCTION EQU 0
CYDEV_CHIP_REV_PSOC5TM_ES0 EQU 0
CYDEV_CHIP_REV_PSOC5TM_ES1 EQU 1
CYDEV_CHIP_REV_PSOC5TM_PRODUCTION EQU 1
CYDEV_CHIP_REV_TMA4_ES EQU 17
CYDEV_CHIP_REV_TMA4_ES2 EQU 33
CYDEV_CHIP_REV_TMA4_PRODUCTION EQU 17
CYDEV_CHIP_REVISION_3A_ES1 EQU 0
CYDEV_CHIP_REVISION_3A_ES2 EQU 1
CYDEV_CHIP_REVISION_3A_ES3 EQU 3
CYDEV_CHIP_REVISION_3A_PRODUCTION EQU 3
CYDEV_CHIP_REVISION_4A_ES0 EQU 17
CYDEV_CHIP_REVISION_4A_PRODUCTION EQU 17
CYDEV_CHIP_REVISION_4D_PRODUCTION EQU 0
CYDEV_CHIP_REVISION_4E_CCG2_NO_USBPD EQU 0
CYDEV_CHIP_REVISION_4E_PRODUCTION EQU 0
CYDEV_CHIP_REVISION_4F_PRODUCTION EQU 0
CYDEV_CHIP_REVISION_4F_PRODUCTION_256DMA EQU 0
CYDEV_CHIP_REVISION_4F_PRODUCTION_256K EQU 0
CYDEV_CHIP_REVISION_4G_ES EQU 17
CYDEV_CHIP_REVISION_4G_ES2 EQU 33
CYDEV_CHIP_REVISION_4G_PRODUCTION EQU 17
CYDEV_CHIP_REVISION_4H_PRODUCTION EQU 0
CYDEV_CHIP_REVISION_4I_PRODUCTION EQU 0
CYDEV_CHIP_REVISION_4J_PRODUCTION EQU 0
CYDEV_CHIP_REVISION_4K_PRODUCTION EQU 0
CYDEV_CHIP_REVISION_4L_PRODUCTION EQU 0
CYDEV_CHIP_REVISION_4M_PRODUCTION EQU 0
CYDEV_CHIP_REVISION_4N_PRODUCTION EQU 0
CYDEV_CHIP_REVISION_4O_PRODUCTION EQU 0
CYDEV_CHIP_REVISION_4P_PRODUCTION EQU 0
CYDEV_CHIP_REVISION_4Q_PRODUCTION EQU 0
CYDEV_CHIP_REVISION_4R_PRODUCTION EQU 0
CYDEV_CHIP_REVISION_4S_PRODUCTION EQU 0
CYDEV_CHIP_REVISION_4T_PRODUCTION EQU 0
CYDEV_CHIP_REVISION_4U_PRODUCTION EQU 0
CYDEV_CHIP_REVISION_4V_PRODUCTION EQU 0
CYDEV_CHIP_REVISION_5A_ES0 EQU 0
CYDEV_CHIP_REVISION_5A_ES1 EQU 1
CYDEV_CHIP_REVISION_5A_PRODUCTION EQU 1
CYDEV_CHIP_REVISION_5B_ES0 EQU 0
CYDEV_CHIP_REVISION_5B_PRODUCTION EQU 0
CYDEV_CHIP_REVISION_6A_ES EQU 17
CYDEV_CHIP_REVISION_6A_NO_UDB EQU 33
CYDEV_CHIP_REVISION_6A_PRODUCTION EQU 33
CYDEV_CHIP_REVISION_FM3_PRODUCTION EQU 0
CYDEV_CHIP_REVISION_FM4_PRODUCTION EQU 0
CYDEV_CHIP_REVISION_PDL_FM0P_TYPE1_PRODUCTION EQU 0
CYDEV_CHIP_REVISION_PDL_FM0P_TYPE2_PRODUCTION EQU 0
CYDEV_CHIP_REVISION_PDL_FM0P_TYPE3_PRODUCTION EQU 0
CYDEV_CHIP_REVISION_USED EQU CYDEV_CHIP_REVISION_5B_PRODUCTION
CYDEV_CHIP_REV_EXPECT EQU CYDEV_CHIP_REVISION_USED
CYDEV_CONFIG_FASTBOOT_ENABLED EQU 1
CYDEV_CONFIG_UNUSED_IO_AllowButWarn EQU 0
CYDEV_CONFIG_UNUSED_IO EQU CYDEV_CONFIG_UNUSED_IO_AllowButWarn
CYDEV_CONFIG_UNUSED_IO_AllowWithInfo EQU 1
CYDEV_CONFIG_UNUSED_IO_Disallowed EQU 2
CYDEV_CONFIGURATION_COMPRESSED EQU 1
CYDEV_CONFIGURATION_DMA EQU 0
CYDEV_CONFIGURATION_ECC EQU 1
CYDEV_CONFIGURATION_IMOENABLED EQU CYDEV_CONFIG_FASTBOOT_ENABLED
CYDEV_CONFIGURATION_MODE_COMPRESSED EQU 0
CYDEV_CONFIGURATION_MODE EQU CYDEV_CONFIGURATION_MODE_COMPRESSED
CYDEV_CONFIGURATION_MODE_DMA EQU 2
CYDEV_CONFIGURATION_MODE_UNCOMPRESSED EQU 1
CYDEV_DEBUG_ENABLE_MASK EQU 0x20
CYDEV_DEBUG_ENABLE_REGISTER EQU CYREG_MLOGIC_DEBUG
CYDEV_DEBUGGING_DPS_Disable EQU 3
CYDEV_DEBUGGING_DPS_JTAG_4 EQU 1
CYDEV_DEBUGGING_DPS_JTAG_5 EQU 0
CYDEV_DEBUGGING_DPS_SWD EQU 2
CYDEV_DEBUGGING_DPS_SWD_SWV EQU 6
CYDEV_DEBUGGING_DPS EQU CYDEV_DEBUGGING_DPS_SWD_SWV
CYDEV_DEBUGGING_ENABLE EQU 1
CYDEV_DEBUGGING_XRES EQU 0
CYDEV_DMA_CHANNELS_AVAILABLE EQU 24
CYDEV_ECC_ENABLE EQU 0
CYDEV_HEAP_SIZE EQU 0x80
CYDEV_INSTRUCT_CACHE_ENABLED EQU 1
CYDEV_INTR_RISING EQU 0x00000000
CYDEV_IS_EXPORTING_CODE EQU 0
CYDEV_IS_IMPORTING_CODE EQU 0
CYDEV_PROJ_TYPE EQU 0
CYDEV_PROJ_TYPE_BOOTLOADER EQU 1
CYDEV_PROJ_TYPE_LAUNCHER EQU 5
CYDEV_PROJ_TYPE_LOADABLE EQU 2
CYDEV_PROJ_TYPE_LOADABLEANDBOOTLOADER EQU 4
CYDEV_PROJ_TYPE_MULTIAPPBOOTLOADER EQU 3
CYDEV_PROJ_TYPE_STANDARD EQU 0
CYDEV_PROTECTION_ENABLE EQU 0
CYDEV_STACK_SIZE EQU 0x0800
CYDEV_USE_BUNDLED_CMSIS EQU 1
CYDEV_VARIABLE_VDDA EQU 0
CYDEV_VDDA_MV EQU 5000
CYDEV_VDDD_MV EQU 5000
CYDEV_VDDIO0_MV EQU 5000
CYDEV_VDDIO1_MV EQU 5000
CYDEV_VDDIO2_MV EQU 5000
CYDEV_VDDIO3_MV EQU 5000
CYDEV_VIO0_MV EQU 5000
CYDEV_VIO1_MV EQU 5000
CYDEV_VIO2_MV EQU 5000
CYDEV_VIO3_MV EQU 5000
CYIPBLOCK_ARM_CM3_VERSION EQU 0
CYIPBLOCK_P3_ANAIF_VERSION EQU 0
CYIPBLOCK_P3_CAN_VERSION EQU 0
CYIPBLOCK_P3_CAPSENSE_VERSION EQU 0
CYIPBLOCK_P3_COMP_VERSION EQU 0
CYIPBLOCK_P3_DECIMATOR_VERSION EQU 0
CYIPBLOCK_P3_DFB_VERSION EQU 0
CYIPBLOCK_P3_DMA_VERSION EQU 0
CYIPBLOCK_P3_DRQ_VERSION EQU 0
CYIPBLOCK_P3_DSM_VERSION EQU 0
CYIPBLOCK_P3_EMIF_VERSION EQU 0
CYIPBLOCK_P3_I2C_VERSION EQU 0
CYIPBLOCK_P3_LCD_VERSION EQU 0
CYIPBLOCK_P3_LPF_VERSION EQU 0
CYIPBLOCK_P3_OPAMP_VERSION EQU 0
CYIPBLOCK_P3_PM_VERSION EQU 0
CYIPBLOCK_P3_SCCT_VERSION EQU 0
CYIPBLOCK_P3_TIMER_VERSION EQU 0
CYIPBLOCK_P3_USB_VERSION EQU 0
CYIPBLOCK_P3_VIDAC_VERSION EQU 0
CYIPBLOCK_P3_VREF_VERSION EQU 0
CYIPBLOCK_S8_GPIO_VERSION EQU 0
CYIPBLOCK_S8_IRQ_VERSION EQU 0
CYIPBLOCK_S8_SAR_VERSION EQU 0
CYIPBLOCK_S8_SIO_VERSION EQU 0
CYIPBLOCK_S8_UDB_VERSION EQU 0
DMA_CHANNELS_USED__MASK0 EQU 0x00000000
CYDEV_BOOTLOADER_ENABLE EQU 0
    ENDIF
    END
